## Kconfig
```kconfig
# Kconfig file for package TinyGUI
menuconfig PKG_USING_TINYGUI
    bool "Please add description of TinyGUI in English."
    default n

if PKG_USING_TINYGUI

    config PKG_TINYGUI_PATH
        string
        default "/packages/multimedia/TinyGUI"

    choice
        prompt "Version"
        default PKG_USING_TINYGUI_LATEST_VERSION
        help
            Select the package version

        config PKG_USING_TINYGUI_V100
            bool "v1.0.0"

        config PKG_USING_TINYGUI_LATEST_VERSION
            bool "latest"
    endchoice
          
    config PKG_TINYGUI_VER
       string
       default "v1.0.0"    if PKG_USING_TINYGUI_V100
       default "latest"    if PKG_USING_TINYGUI_LATEST_VERSION

endif
```
